#include <IRremoteESP8266.h> //INCLUSÃO DE BIBLIOTECA

IRsend irsend(14); //FUNÇÃO RESPONSÁVEL PELO MÉTODO DE ENVIO DO SINAL IR / UTILIZA O GPIO14(D5)

int khz = 38; // 38kHz carrier frequency for the NEC protocol
unsigned int LigarSamsung[] = {588,17940,2992,8984,508,492,508,1488,508,492,504,492,508,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1488,512};
unsigned int DesligarSamsung[] = {616,17892,3040,8964,504,520,504,1492,508,488,508,492,508,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1492,504};
unsigned int LigarEletrolux[] = {9040,4492,672,536,672,536,672,532,672,1636,672,536,672,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532,672};
unsigned int DesligarEletrolux[] = {9040,4464,676,532,676,532,672,536,672,532,672,532,676,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1636,676};

unsigned long tInicial=0;
int ar=1, dia=0, hora=0, minuto=0, segundo=0;

void setup(){
  irsend.begin(); //INICIALIZA A FUNÇÃO
  Serial.begin(115200); //INICIALIZA A SERIAL
  tInicial = millis();
}

void loop() {
  Tempo();
  if(dia==0){
    LigDesl();
  }
}


void LigDesl(){
  if(ar == 1){
    irsend.sendRaw(LigarSamsung, sizeof(LigarSamsung) / sizeof(LigarSamsung[0]), khz);
    delay(10);
    irsend.sendRaw(DesligarEletrolux, sizeof(DesligarEletrolux) / sizeof(DesligarEletrolux[0]), khz);  
    ar = 2;
  }
  else{
    irsend.sendRaw(DesligarSamsung, sizeof(DesligarSamsung) / sizeof(DesligarSamsung[0]), khz);
    delay(10);
    irsend.sendRaw(LigarEletrolux, sizeof(LigarEletrolux) / sizeof(LigarEletrolux[0]), khz);
    ar = 1;    
  }
}
void Tempo(){
  Serial.println(minuto);
  segundo = ((millis() - tInicial)/1000);
  if(segundo > 59){
    tInicial = millis();
    minuto++;
  }
  if(minuto == 60){
    minuto = 0;
    hora++;
  }
  if(hora == 24){
    hora = 0;
    dia++;
  }
  if(dia == 7){
    dia = 0;
  }
}
